## config/west.yml
```yaml
manifest:
  remotes:
    - name: duboo94
      url-base: https://github.com/duboo94
  projects:
    - name: zmk
      remote: duboo94
      revision: main
      import: app/west.yml
    - name: zmk-pmw3610-driver
      remote: duboo94
      revision: main
  self:
    path: config
```
